/dts-v1/;
/plugin/;

/ {
	compatible = "allwinner,sun8i-h3";

	fragment@0 {
		target = <&pio>;
		__overlay__ {
			spi0_cs1: spi0_cs1 {
				pins = "PC7";
				function = "gpio_out";
				output-high;
			};

		};
	};

	fragment@1 {
		target = <&spi0>;
		__overlay__ {
			pinctrl-names = "default", "default";
			pinctrl-1 = <&spi0_cs1>;
			cs-gpios = <0>, <&pio 2 7 0>; /* PC7 */
		};
	};

};
